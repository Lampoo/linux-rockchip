## Documentation/devicetree/bindings/media/rockchip-mpp-service.txt
```
* Rockchip MPP SERVICE

Rockchip MPP (SERVICE) is the service module present kernel which
maintain a workqueue for different mpp device to queue the work.

Because some multimedia devices in Rockchip SoCs share the resources, such
as RK312x, vpu and rkvdec share the registers and inner ram, and these devices
cannot running in the same time, therefor, a service maintain unit queue is
required.

Required properties:
  - compatible : value should be either one among the following
	(a) "rockchip,mpp_service" for a common version present in Rockchip SoCs

Optional properties:

  - reg : Physical base address of the combo IP registers and length of memory
	  mapped region.

Example:
SoC specific DT entry:

rkvenc_srv: rkvenc_srv {
	compatible = "rockchip,mpp_service";
};
```

## arch/arm64/mach-rockchip/Kconfig
```kconfig
# SPDX-License-Identifier: GPL-2.0
source "arch/arm/mach-rockchip/Kconfig.common"
```

## drivers/gps/Kconfig
```kconfig
#
# GPS device configuration
#

#if GPS_SUPPORT
config GPS
	tristate "GPS power enalbed"
	default y
	help
	  Rv1108 GPS Driver
#endif
```

## drivers/iio/proximity/Kconfig
```kconfig
#
# Proximity sensors
#

menu "Proximity sensors"

config ISL29501
	tristate "Intersil ISL29501 Time Of Flight sensor"
	depends on I2C
	select IIO_BUFFER
	select IIO_TRIGGERED_BUFFER
	select IIO_KFIFO_BUF
	help
	  Say Y here if you want to build a driver for the Intersil ISL29501
	  Time of Flight sensor.

	  To compile this driver as a module, choose M here: the module will be
	  called isl29501.
endmenu
```

## drivers/input/touchscreen/gt910/Kconfig
```kconfig
# SPDX-License-Identifier: GPL-2.0
config TOUCHSCREEN_GT910
	tristate "goodix gt910 touchscreen"
	depends on I2C
	help
	  Say Y here if you have a goodix gt910 touchscreen.
```

## drivers/net/wireless/rockchip_wlan/rtl8189es/Kconfig
```kconfig
# SPDX-License-Identifier: GPL-2.0
config RTL8189ES
        tristate "Realtek 8189ES/ETV SDIO WiFi Support"
        depends on MMC
        select WIRELESS_EXT
        select WEXT_PRIV
        select IEEE80211
        ---help---
          Help message of RTL8189ETV & RTL8189ES
```

## drivers/net/wireless/rockchip_wlan/rtl8723bs-vq0/Kconfig
```kconfig
# SPDX-License-Identifier: GPL-2.0
config RTL8723BS_VQ0
	tristate "Realtek 8723BS_VQ0 WiFi"
	---help---
	  Help message of RTL8723BS-VQ0
```

## drivers/net/wireless/rockchip_wlan/rtl8822bs/Kconfig
```kconfig
# SPDX-License-Identifier: GPL-2.0
config RTL8822BS
	tristate "Realtek 8822BS SDIO WiFi"
	---help---
	  Help message of RTL8822BS
```

## drivers/net/wireless/rockchip_wlan/rtl8822bu/Kconfig
```kconfig
# SPDX-License-Identifier: GPL-2.0
config RTL8822BU
	tristate "Realtek 8822B USB WiFi"
	depends on USB
	---help---
	  Help message of RTL8822BU
```

## drivers/soc/Kconfig
```kconfig
# SPDX-License-Identifier: GPL-2.0
menu "SOC (System On Chip) specific Drivers"

source "drivers/soc/rockchip/Kconfig"

endmenu
```

## drivers/video/rockchip/mpp/Kconfig
```kconfig
menu "ROCKCHIP_MPP"
	depends on ARCH_ROCKCHIP

config ROCKCHIP_MPP
	tristate "ROCKCHIP MPP driver"
	default y
	help
	  rockchip mpp module.

endmenu
```
